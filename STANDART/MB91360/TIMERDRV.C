
//#include "include.h"

/*  Программа инициализации послед.порта, его прерывания и буферов для прерывания.  */

void  Init_timer ( void )
{
  TCCS0_STOP=1;    /* Для инициализации останавливаем счетчик*/

//  6: TCCS0_IVF  = 0;    /* очищаем флаг запроса */
//  5: TCCS0_IVFE = 1;    /* разрешение прерывания */
//  4: TCCS0_STOP = 1;    /* Для инициализации останавливаем счетчик*/

//  3: TCCS0_MODE = 0;    /* инициализация по сбросу или биту CLR */
//  2: TCCS0_CLR  = 1;    /* устанавливаем счетчик в 0X0000  */
//  1: TCCS0_CLK1 = 0;    /* Дискрета - 1 мкс (R-bus clk)/16 */
//  0: TCCS0_CLK0 = 1;

    timer1 = 0;
    timer2 = 0;
    TCCS0 = 0x35;  //0011 0101 т.к. R-bus clk = 16 МГц.
    TCCS1 = 0x15;  //0011 0101 т.к. R-bus clk = 16 МГц.

  ICR32 = 19; //Приоритет прерывания по таймеру0

  TCCS0_STOP=0;    /* Включаем счетчик*/
  TCCS1_STOP=0;    /* Включаем счетчик*/

  //ДДДДДДДДДДДДДДДДДД Инижиализажип вбее ваймеаов ДДДДДДДДДДДДДДДДДДДДД
    timer1 = 0,  Timer1_Ovr = 0,  Timer1_fSec = 0 ;

  return   ;
}
/*ДДДДДДДДДДДДДДДДДДДДДДДДДДДДДДДДДДДДД-  */

__interrupt void Timer_Interrupt (void)
{
  asm_ei();
  TCCS0_IVF = 0;   /* очищаем флаг запроса */
  //++PDRM_PDM1 ;
  ++Timer1_Ovr;
  //Ovr_Time_Schet(&msg_reg.time);

      /*--------------------------------------------------------------------------
       *    Используется для вывода информации на дисплей в режиме "бегущей строки".
       *  Информация для вывода берется из того же буфера вывода, что и преры-
       *  ванием по TXD, по-этому эти два прерывания одновременно не совместимы.
       *  При переходе от вывода по TXD к выводу по прерываниям по переполнению
       *  Timer1, необходимо:
       *    int_mask1 &=  ~TXD_IntEnable ; - запретить прерывание по TXD ;
       *    Mon.Pult = 1 ;   - установить признак работы с пультом "бегущая строка",
       *      что используется для обхода записи "затравки" в TXD из рабочих программ.
       *
       *  При переходе от вывода по Timer1 к TXD, необходимо:
       *    Mon.Pult = 0 ;   - сбросить признак работы с пультом "бегущая строка",
       *       что разрешит запись "затравки" в TXD из рабочих программ для запуска
       *       прерываний по TXD ;
       *    int_mask1 |= TXD_IntEnable  ;   - разрешить прерывание по TXD.
       */
       if ( Mon.UartCAN_Connect == 0 )
       {
         if ( Mon.Pult == 1 )
          {
            if ( --Count_SymbolPauza == 0 )  // отсчет паузы между символами
              {
                Count_SymbolPauza = _SymbolPauza ;
                if ( mTestYesData_in_Buff_TXD() )
                  {
                    mSymbol_from_Buff_TXD( SODR0 ) ;
          }   }   }
       }
	return;
}

